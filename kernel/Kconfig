## kernel/oplus_cpu/Kconfig
```kconfig
# SPDX-License-Identifier: GPL-2.0-only
# Copyright (C) 2018-2022 Oplus. All rights reserved.

config OPLUS_FEATURE_GEAS
        tristate "geas"
        default n
        help
          turning for game

config OPLUS_FEATURE_CPU
	bool "oplus cpu feature"
    default n
	help
	  Add for CPU Feature

source "kernel/oplus_cpu/cpufreq_health/Kconfig"
source "kernel/oplus_cpu/cpufreq_bouncing/Kconfig"
source "kernel/oplus_cpu/sched/Kconfig"
source "kernel/oplus_cpu/uad/Kconfig"
source "kernel/oplus_cpu/oplus_slc/Kconfig"
source "kernel/oplus_cpu/oplus_omrg/Kconfig"
source "kernel/oplus_cpu/oplus_overload/Kconfig"
source "kernel/oplus_cpu/waker_identify/Kconfig"
source "kernel/oplus_cpu/oplus_game/Kconfig"
source "kernel/oplus_cpu/close_loop/Kconfig"
source "kernel/oplus_cpu/smart_freq/Kconfig"
source "kernel/oplus_cpu/freq_tune_policy/Kconfig"
```
